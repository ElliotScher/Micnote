## CMakeLists.txt
```
# BLE end to end in BabbleSim (see ../README.md): the puck's real BLE module,
# dispatcher, host slots and recording store, against a simulated host.
cmake_minimum_required(VERSION 3.20.0)
find_package(Zephyr REQUIRED HINTS $ENV{ZEPHYR_BASE})
project(micnote_bsim_link)

add_subdirectory(${ZEPHYR_BASE}/tests/bsim/babblekit babblekit)
target_link_libraries(app PRIVATE babblekit)

set(MICNOTE_APP_SRC ${CMAKE_CURRENT_SOURCE_DIR}/../../app/src)
set(MICNOTE_PROTO_GEN ${CMAKE_CURRENT_SOURCE_DIR}/../../../proto/gen)

target_include_directories(app PRIVATE
  ${MICNOTE_APP_SRC}/ble ${MICNOTE_APP_SRC}/crypto ${MICNOTE_APP_SRC}/storage
  ${MICNOTE_APP_SRC}/proto_link ${MICNOTE_PROTO_GEN})
target_sources(app PRIVATE
  src/main.c
  src/puck.c
  src/host.c
  src/stranger.c
  src/host_link.c
  ${MICNOTE_APP_SRC}/ble/ble.c
  ${MICNOTE_APP_SRC}/ble/adv.c
  ${MICNOTE_APP_SRC}/ble/gatt_svc.c
  ${MICNOTE_APP_SRC}/ble/l2cap.c
  ${MICNOTE_APP_SRC}/proto_link/dispatch.c
  ${MICNOTE_APP_SRC}/proto_link/framing.c
  ${MICNOTE_APP_SRC}/storage/recstore.c
  ${MICNOTE_APP_SRC}/storage/mnr.c
  ${MICNOTE_APP_SRC}/storage/hosts.c
  ${MICNOTE_APP_SRC}/crypto/wrap.c
  ${MICNOTE_APP_SRC}/crypto/aead.c
  ${MICNOTE_APP_SRC}/crypto/keys.c
  ${MICNOTE_APP_SRC}/crypto/pairing.c
  ${MICNOTE_PROTO_GEN}/micnote.pb.c
)
zephyr_include_directories(
  ${BSIM_COMPONENTS_PATH}/libUtilv1/src/
  ${BSIM_COMPONENTS_PATH}/libPhyComv1/src/
)
```

## prj.conf
```kconfig
# Bluetooth as the puck uses it (stage 1 §4.7). The host and stranger roles
# share the image, hence CENTRAL as well.
CONFIG_BT=y
CONFIG_BT_PERIPHERAL=y
CONFIG_BT_CENTRAL=y
CONFIG_BT_GATT_CLIENT=y
CONFIG_BT_DEVICE_NAME="Micnote"
CONFIG_BT_MAX_CONN=2
CONFIG_BT_SMP=y
CONFIG_BT_BONDABLE=y
CONFIG_BT_SMP_APP_PAIRING_ACCEPT=y
CONFIG_BT_PRIVACY=y
CONFIG_BT_RPA_TIMEOUT=900
CONFIG_BT_SETTINGS=y
CONFIG_BT_L2CAP_DYNAMIC_CHANNEL=y
# The test host receives segments itself (host_link.c); the puck doesn't.
CONFIG_BT_L2CAP_SEG_RECV=y
CONFIG_BT_USER_PHY_UPDATE=y
CONFIG_BT_USER_DATA_LEN_UPDATE=y
CONFIG_BT_L2CAP_TX_MTU=247
CONFIG_BT_BUF_ACL_RX_SIZE=251
CONFIG_BT_BUF_ACL_TX_SIZE=251
CONFIG_BT_CTLR_DATA_LENGTH_MAX=251
CONFIG_BT_ATT_PREPARE_COUNT=0
# Ask for the transfer parameters 1 s into a connection rather than
# Zephyr's default 5 s (the start of every sync would run slow otherwise).
CONFIG_BT_CONN_PARAM_UPDATE_TIMEOUT=1000
# Leave connection parameters to the code under test.
CONFIG_BT_GAP_AUTO_UPDATE_CONN_PARAMS=n
CONFIG_BT_AUTO_PHY_UPDATE=n
CONFIG_BT_AUTO_DATA_LEN_UPDATE=n
CONFIG_BT_EATT=n
CONFIG_BT_L2CAP_ECRED=n

# Bonds, host slots and the fallback/link keys: settings on NVS, PSA
# persistent keys in Zephyr's secure storage over the same settings.
CONFIG_FLASH=y
CONFIG_FLASH_MAP=y
CONFIG_NVS=y
CONFIG_SETTINGS=y
CONFIG_SETTINGS_NVS=y
CONFIG_SECURE_STORAGE=y
CONFIG_SECURE_STORAGE_ITS_STORE_IMPLEMENTATION_SETTINGS=y

# Recordings.
CONFIG_FILE_SYSTEM=y
CONFIG_FILE_SYSTEM_LITTLEFS=y

# The firmware's PSA set (tests/dispatch), plus key generation.
CONFIG_ENTROPY_GENERATOR=y
CONFIG_PSA_CRYPTO=y
CONFIG_PSA_WANT_ECC_MONTGOMERY_255=y
CONFIG_PSA_WANT_KEY_TYPE_ECC_KEY_PAIR_IMPORT=y
CONFIG_PSA_WANT_KEY_TYPE_ECC_KEY_PAIR_GENERATE=y
CONFIG_PSA_WANT_KEY_TYPE_ECC_PUBLIC_KEY=y
CONFIG_PSA_WANT_ALG_ECDH=y
CONFIG_PSA_WANT_ALG_HKDF=y
CONFIG_PSA_WANT_ALG_HMAC=y
CONFIG_PSA_WANT_KEY_TYPE_HMAC=y
CONFIG_PSA_WANT_KEY_TYPE_DERIVE=y
CONFIG_PSA_WANT_ALG_SHA_256=y
CONFIG_PSA_WANT_KEY_TYPE_AES=y
CONFIG_PSA_WANT_ALG_CCM=y

# With Bluetooth, Mbed TLS allocates from its own heap (2 KB by default),
# and X25519 alone needs more: PSA_ERROR_INSUFFICIENT_MEMORY otherwise. The
# board builds need the same (native_sim uses the host's malloc instead).
CONFIG_MBEDTLS_ENABLE_HEAP=y
CONFIG_MBEDTLS_HEAP_SIZE=8192

CONFIG_NANOPB=y
CONFIG_MAIN_STACK_SIZE=16384
CONFIG_SYSTEM_WORKQUEUE_STACK_SIZE=4096
CONFIG_LOG=y
CONFIG_ASSERT=y
```

## boards/nrf52_bsim.overlay
```dts
/* Split the simulated 512 KB flash: settings (bonds, host slots, keys) and
 * the recordings, as the puck splits its NVS and its QSPI flash. */
/delete-node/ &storage_partition;

&flash0 {
	partitions {
		storage_partition: partition@0 {
			label = "storage";
			reg = <0x00000000 DT_SIZE_K(64)>;
		};
		rec_partition: partition@10000 {
			label = "recordings";
			reg = <0x00010000 DT_SIZE_K(448)>;
		};
	};
};
```

## src/main.c
```c
/* BabbleSim test registration: one image, three roles chosen by -testid. */
#include "bstests.h"
#include "roles.h"

static const struct bst_test_instance tests[] = {
    {.test_id = "puck", .test_descr = "The puck: BLE, dispatcher, store", .test_main_f = puck_main},
    {.test_id = "host",
     .test_descr = "A host: bond, pair, sync, authenticate",
     .test_main_f = host_main},
    {.test_id = "stranger",
     .test_descr = "An unpaired central, after the window",
     .test_main_f = stranger_main},
    BSTEST_END_MARKER,
};

static struct bst_test_list *install(struct bst_test_list *list)
{
    return bst_add_tests(list, tests);
}

bst_test_install_t test_installers[] = {install, NULL};

int main(void)
{
    bst_main();
    return 0;
}
```

## src/host.c
```c
/*
 * The host role, a paired host's whole life over BLE:
 *
 * 1. Find the puck by its advertising (sync_pending set), connect, bond with
 *    LE Secure Connections (the puck's pairing window is open).
 * 2. Read the PSM, open the L2CAP channel, pair at the app layer (protocol
 *    section 8), list, fetch, decrypt and ack both memos: they were on the
 *    puck's fallback key, and pairing moved them to this host.
 * 3. Reconnect: re-encrypt with the bond, authenticate with the link key
 *    (device_proof, Auth), check the status characteristic.
 * 4. Reconnect over the GATT fallback (ctrl/data): authenticate, ListHosts.
 */
#include <errno.h>
#include <string.h>

#include <zephyr/bluetooth/bluetooth.h>
#include <zephyr/kernel.h>
#include <zephyr/settings/settings.h>
#include <zephyr/sys/byteorder.h>

#include <psa/crypto.h>

#include "aead.h"
#include "babblekit/testcase.h"
#include "ble.h"
#include "mnr.h"
#include "pairing.h"
#include "recstore.h"
#include "roles.h"
#include "wrap.h"

/* RFC 7748 section 6.1's Bob: test vectors' host_a. */
static const uint8_t host_priv[32] = {
    0x5d, 0xab, 0x08, 0x7e, 0x62, 0x4a, 0x8a, 0x4b, 0x79, 0xe1, 0x7f, 0x8b, 0x83, 0x80, 0x0e, 0xe6,
    0x6f, 0x3b, 0xb1, 0x29, 0x26, 0x18, 0xb6, 0xfd, 0x1c, 0x2f, 0x8b, 0x27, 0xff, 0x88, 0xe0, 0xeb};
static psa_key_id_t host_key;
static uint8_t host_pub[32];
static uint8_t host_id[8];
static psa_key_id_t link_key = PSA_KEY_ID_NULL;

static micnote_v1_Frame req;
static micnote_v1_Frame resp;
static uint8_t n_h[16];
static uint8_t n_d[16];
static uint8_t device_id[8];

static void expect(pb_size_t tag, const char *what)
{
    TEST_ASSERT(resp.which_body == tag, "%s: got body %u (error %d)", what, resp.which_body,
                resp.which_body == micnote_v1_Frame_error_tag ? resp.body.error.code : 0);
}

static void call(pb_size_t tag, pb_size_t want, const char *what, uint32_t timeout_ms)
{
    req.which_body = tag;
    TEST_ASSERT(hl_call(&req, &resp, timeout_ms) == 0, "%s: no answer", what);
    expect(want, what);
    memset(&req, 0, sizeof(req));
}

static void hello(void)
{
    TEST_ASSERT(psa_generate_random(n_h, sizeof(n_h)) == PSA_SUCCESS, "nonce");
    req.body.hello.proto_version = 1;
    memcpy(req.body.hello.host_id, host_id, 8);
    memcpy(req.body.hello.host_nonce, n_h, 16);
    call(micnote_v1_Frame_hello_tag, micnote_v1_Frame_hello_ack_tag, "Hello", 5000);
    memcpy(n_d, resp.body.hello_ack.device_nonce, 16);
    memcpy(device_id, resp.body.hello_ack.device_info.device_id, 8);
}

/* Hello + device_proof + Auth with the link key from pairing. */
static void authenticate(void)
{
    hello();
    TEST_ASSERT(resp.body.hello_ack.device_proof.size == 32, "no device_proof");
    TEST_ASSERT(mn_pair_proof_verify(link_key, MN_PROOF_PUCK, n_h, n_d,
                                     resp.body.hello_ack.device_proof.bytes) == 0,
                "device_proof doesn't verify: not our puck");
    TEST_ASSERT(mn_pair_proof(link_key, MN_PROOF_HOST, n_h, n_d, req.body.auth.host_proof) == 0,
                "proof");
    call(micnote_v1_Frame_auth_tag, micnote_v1_Frame_ok_tag, "Auth", 5000);
}

static void pair(void)
{
    uint8_t sas[MN_SAS_SYMBOLS];

    hello();
    TEST_ASSERT(resp.body.hello_ack.device_proof.size == 0, "proof from an unpaired puck");
    memcpy(req.body.pair_begin.host_pub, host_pub, 32);
    strcpy(req.body.pair_begin.host_name, "bsim host");
    call(micnote_v1_Frame_pair_begin_tag, micnote_v1_Frame_pair_challenge_tag, "PairBegin", 5000);
    memcpy(n_d, resp.body.pair_challenge.device_nonce, 16);

    /* The host's side of protocol section 8. The link key's inputs are
     * symmetric (ss, host_id, device_id); the SAS's order of public keys
     * isn't, so this test doesn't compare SAS colours (tests/pairing and
     * core's tests check the SAS against known answers). */
    TEST_ASSERT(mn_pair_derive(host_key, host_pub, resp.body.pair_challenge.device_pub, host_id,
                               device_id, n_h, n_d, &link_key, sas) == 0,
                "derive");
    req.body.pair_confirm.user_confirmed = true;
    call(micnote_v1_Frame_pair_confirm_tag, micnote_v1_Frame_pair_done_tag, "PairConfirm", 10000);
    TEST_PRINT("host: paired, slot %u", resp.body.pair_done.host_slot);
}

/* Fetches one recording, checks this host can decrypt it, and acks it. */
static void sync_one(uint64_t id)
{
    static uint8_t file[32 * 1024];
    static struct mn_mnr_header h;
    static uint8_t pt[MN_MNR_MAX_CT];
    size_t len = 0;
    uint32_t chunks = 0;
    const int64_t t0 = k_uptime_get();
    const size_t rx0 = hl_rx_bytes();

    /* Chunk records go first; the header (from FetchDone) goes in front. */
    static uint8_t records[32 * 1024];
    size_t rec_len = 0;

    req.body.fetch.recording_id = id;
    req.which_body = micnote_v1_Frame_fetch_tag;
    TEST_ASSERT(hl_call(&req, &resp, 10000) == 0, "Fetch: no answer");
    memset(&req, 0, sizeof(req));
    while (resp.which_body == micnote_v1_Frame_chunk_tag) {
        const struct mn_mnr_chunk_hdr ch = {
            .seq = resp.body.chunk.seq, .ct_len = (uint16_t)(resp.body.chunk.payload.size - 16)};

        TEST_ASSERT(ch.seq == chunks, "chunk %u out of order", ch.seq);
        mn_mnr_chunk_hdr_write(&ch, &records[rec_len]);
        memcpy(&records[rec_len + 6], resp.body.chunk.payload.bytes, resp.body.chunk.payload.size);
        rec_len += 6 + resp.body.chunk.payload.size;
        chunks++;
        TEST_ASSERT(hl_next(&resp, 10000) == 0, "Fetch: stream stopped");
    }
    expect(micnote_v1_Frame_fetch_done_tag, "FetchDone");
    const int64_t ms = MAX(k_uptime_get() - t0, 1);
    const size_t bytes = hl_rx_bytes() - rx0;

    TEST_PRINT("host: fetched %016llx: %u chunks, %u bytes in %lld ms (%u KB/s simulated)",
               (unsigned long long)id, chunks, (unsigned)bytes, ms,
               (unsigned)(bytes * 1000 / 1024 / ms));
    memcpy(file, resp.body.fetch_done.header.bytes, resp.body.fetch_done.header.size);
    len = resp.body.fetch_done.header.size;
    memcpy(&file[len], records, rec_len);
    len += rec_len;

    /* Decrypt the first chunk as this host: the wrap must be ours now. */
    uint8_t cek[MN_CEK_SIZE];
    uint8_t core_hash[32];
    psa_key_id_t cek_key;
    int slot = -1;
    const int hdr_len = mn_mnr_header_parse(file, len, &h);

    TEST_ASSERT(hdr_len > 0, "header");
    for (int i = 0; i < h.n_wraps; i++) {
        if (memcmp(h.wraps[i].host_id, host_id, 8) == 0) {
            slot = i;
        }
    }
    TEST_ASSERT(slot >= 0, "not wrapped to this host: pairing didn't move it");
    TEST_ASSERT(mn_unwrap_cek(host_key, id, &h.wraps[slot], cek) == 0, "unwrap");
    TEST_ASSERT(mn_cek_import(cek, &cek_key) == 0, "cek");
    TEST_ASSERT(mn_header_core_hash(file, core_hash) == 0, "core hash");
    struct mn_mnr_chunk_hdr ch;

    TEST_ASSERT(mn_mnr_chunk_hdr_parse(&file[hdr_len], &ch) == 0, "chunk header");
    TEST_ASSERT(mn_chunk_open(cek_key, id, ch.seq, core_hash, &file[hdr_len + 6], ch.ct_len + 16,
                              pt, sizeof(pt)) == ch.ct_len,
                "chunk doesn't authenticate");
    psa_destroy_key(cek_key);

    size_t hlen;

    TEST_ASSERT(
        psa_hash_compute(PSA_ALG_SHA_256, file, len, req.body.ack.sha256, 32, &hlen) == PSA_SUCCESS,
        "hash");
    req.body.ack.recording_id = id;
    call(micnote_v1_Frame_ack_tag, micnote_v1_Frame_ok_tag, "Ack", 5000);
}

static uint16_t read_psm(struct bt_conn *conn)
{
    uint8_t v[2];

    const int r = hl_read(conn, 0x03, v, sizeof(v));

    TEST_ASSERT(r == 2, "psm read: %d", r);
    return sys_get_le16(v);
}

void host_main(void)
{
    bool pending;
    size_t len;
    uint8_t hash[32];
    uint8_t status[MN_BLE_STATUS_LEN];

    TEST_ASSERT(psa_crypto_init() == PSA_SUCCESS, "psa");
    TEST_ASSERT(mn_x25519_import(host_priv, &host_key) == 0, "host key");
    TEST_ASSERT(psa_export_public_key(host_key, host_pub, 32, &len) == PSA_SUCCESS, "pub");
    TEST_ASSERT(psa_hash_compute(PSA_ALG_SHA_256, host_pub, 32, hash, 32, &len) == PSA_SUCCESS,
                "id");
    memcpy(host_id, hash, 8);
    /* Bonds and the identity address live in settings (CONFIG_BT_SETTINGS). */
    TEST_ASSERT(settings_subsys_init() == 0, "settings");
    TEST_ASSERT(bt_enable(NULL) == 0, "bt");
    TEST_ASSERT(settings_load() == 0, "settings load");

    /* 1-2: bond, pair, sync over L2CAP. */
    struct bt_conn *conn = hl_connect(&pending);

    TEST_ASSERT(pending, "the puck should advertise sync_pending");
    TEST_ASSERT(hl_encrypt(conn) == 0, "bonding");
    const uint16_t psm = read_psm(conn);

    TEST_ASSERT(hl_open(conn, HL_L2CAP, psm) == 0, "L2CAP to psm 0x%04x", psm);
    TEST_PRINT("host: L2CAP open on psm 0x%04x, tx MTU %u", psm, hl_l2cap_tx_mtu());
    pair();
    req.body.set_time.unix_ms = 1763900000000ULL;
    call(micnote_v1_Frame_set_time_tag, micnote_v1_Frame_ok_tag, "SetTime", 5000);
    call(micnote_v1_Frame_list_recordings_tag, micnote_v1_Frame_recording_list_tag, "List", 5000);
    TEST_ASSERT(resp.body.recording_list.entries_count == 2, "%u recordings",
                resp.body.recording_list.entries_count);
    const uint64_t ids[2] = {resp.body.recording_list.entries[0].id,
                             resp.body.recording_list.entries[1].id};

    /* The puck asks for 15 ms (12 x 1.25 ms) once the channel is busy. */
    uint16_t interval;
    uint16_t latency;

    hl_interval(&interval, &latency);
    TEST_ASSERT(interval == 12 && latency == 0, "transfer interval %u, latency %u", interval,
                latency);
    sync_one(ids[0]);
    sync_one(ids[1]);
    call(micnote_v1_Frame_list_recordings_tag, micnote_v1_Frame_recording_list_tag, "List", 5000);
    TEST_ASSERT(resp.body.recording_list.entries_count == 0, "acked recordings still listed");
    hl_disconnect(conn);

    /* 3: back with the bond and the link key. */
    conn = hl_connect(&pending);
    TEST_ASSERT(!pending, "nothing left to sync");
    TEST_ASSERT(hl_encrypt(conn) == 0, "re-encryption with the bond");
    TEST_ASSERT(hl_read(conn, 0x04, status, sizeof(status)) == MN_BLE_STATUS_LEN, "status");
    TEST_ASSERT(status[0] == 80, "status battery %u", status[0]);
    TEST_ASSERT(hl_open(conn, HL_L2CAP, read_psm(conn)) == 0, "L2CAP again");
    authenticate();
    call(micnote_v1_Frame_get_status_tag, micnote_v1_Frame_device_status_tag, "GetStatus", 5000);
    TEST_ASSERT(resp.body.device_status.recording_count == 0, "status count");
    /* Quiet for a while: back to the idle interval (100-500 ms, latency 4). */
    k_sleep(K_MSEC(MN_BLE_IDLE_MS + 2000));
    hl_interval(&interval, &latency);
    TEST_ASSERT(interval >= 80 && interval <= 400 && latency == 4, "idle interval %u, latency %u",
                interval, latency);
    hl_disconnect(conn);

    /* 4: the GATT fallback. */
    conn = hl_connect(&pending);
    TEST_ASSERT(hl_encrypt(conn) == 0, "re-encryption");
    TEST_ASSERT(hl_open(conn, HL_GATT, 0) == 0, "GATT stream");
    authenticate();
    call(micnote_v1_Frame_list_hosts_tag, micnote_v1_Frame_host_list_tag, "ListHosts", 5000);
    TEST_ASSERT(resp.body.host_list.hosts_count == 1, "hosts");
    TEST_ASSERT(strcmp(resp.body.host_list.hosts[0].name, "bsim host") == 0, "host name");
    hl_disconnect(conn);

    TEST_PASS("host: bonded, paired, synced over L2CAP, authenticated over L2CAP and GATT");
}
```

## src/host_link.c
```c
/*
 * The test host's BLE plumbing: scan for the puck, connect, encrypt, read a
 * characteristic, and carry framed requests and responses over L2CAP or the
 * GATT fallback. A test-only stand-in for core's SimpleBLE transport.
 */
#include <errno.h>
#include <string.h>

#include <zephyr/bluetooth/bluetooth.h>
#include <zephyr/bluetooth/gatt.h>
#include <zephyr/bluetooth/l2cap.h>
#include <zephyr/kernel.h>
#include <zephyr/net_buf.h>
#include <zephyr/sys/byteorder.h>
#include <zephyr/sys/ring_buffer.h>

#include "adv.h"
#include "babblekit/testcase.h"
#include "ble.h"
#include "framing.h"
#include "roles.h"

/* ---- connect ------------------------------------------------------------- */

static K_SEM_DEFINE(found, 0, 1);
static K_SEM_DEFINE(conn_done, 0, 1);
static K_SEM_DEFINE(sec_done, 0, 1);
static bt_addr_le_t found_addr;
static bool found_sync_pending;
static uint8_t conn_err;
static int sec_err;
static struct bt_conn *conn_now;

static void on_scan(const bt_addr_le_t *addr, int8_t rssi, uint8_t type, struct net_buf_simple *ad)
{
    bool pending;

    ARG_UNUSED(rssi);
    if (type != BT_GAP_ADV_TYPE_ADV_IND || !mn_adv_parse(ad->data, ad->len, &pending)) {
        return;
    }
    if (bt_le_scan_stop() == 0) {
        bt_addr_le_copy(&found_addr, addr);
        found_sync_pending = pending;
        k_sem_give(&found);
    }
}

static void on_connected(struct bt_conn *conn, uint8_t err)
{
    if (conn == conn_now) {
        conn_err = err;
        k_sem_give(&conn_done);
    }
}

static void on_security(struct bt_conn *conn, bt_security_t level, enum bt_security_err err)
{
    if (conn == conn_now) {
        sec_err = err != BT_SECURITY_ERR_SUCCESS ? (int)err : (level < BT_SECURITY_L2 ? -1 : 0);
        k_sem_give(&sec_done);
    }
}

static uint16_t last_interval;
static uint16_t last_latency;

static void on_params(struct bt_conn *conn, uint16_t interval, uint16_t latency, uint16_t timeout)
{
    ARG_UNUSED(timeout);
    if (conn == conn_now) {
        last_interval = interval;
        last_latency = latency;
        TEST_PRINT("host: connection interval %u.%02u ms, latency %u", interval * 125 / 100,
                   interval * 125 % 100, latency);
    }
}

static void on_phy(struct bt_conn *conn, struct bt_conn_le_phy_info *info)
{
    if (conn == conn_now) {
        TEST_PRINT("host: PHY tx %u rx %u", info->tx_phy, info->rx_phy);
    }
}

static void on_data_len(struct bt_conn *conn, struct bt_conn_le_data_len_info *info)
{
    if (conn == conn_now) {
        TEST_PRINT("host: data length tx %u rx %u", info->tx_max_len, info->rx_max_len);
    }
}

BT_CONN_CB_DEFINE(host_callbacks) = {
    .connected = on_connected,
    .security_changed = on_security,
    .le_param_updated = on_params,
    .le_phy_updated = on_phy,
    .le_data_len_updated = on_data_len,
};

struct bt_conn *hl_connect(bool *sync_pending)
{
    k_sem_reset(&found);
    TEST_ASSERT(bt_le_scan_start(BT_LE_SCAN_PASSIVE, on_scan) == 0, "scan");
    TEST_ASSERT(k_sem_take(&found, K_SECONDS(30)) == 0, "no puck advertising");
    *sync_pending = found_sync_pending;

    k_sem_reset(&conn_done);
    const int err =
        bt_conn_le_create(&found_addr, BT_CONN_LE_CREATE_CONN, BT_LE_CONN_PARAM_DEFAULT, &conn_now);

    TEST_ASSERT(err == 0, "connect: %d", err);
    TEST_ASSERT(k_sem_take(&conn_done, K_SECONDS(10)) == 0 && conn_err == 0, "connect failed");
    return conn_now;
}

void hl_disconnect(struct bt_conn *conn)
{
    (void)bt_conn_disconnect(conn, BT_HCI_ERR_REMOTE_USER_TERM_CONN);
    for (int i = 0; i < 100; i++) {
        struct bt_conn_info info;

        if (bt_conn_get_info(conn, &info) != 0 || info.state == BT_CONN_STATE_DISCONNECTED) {
            break;
        }
        k_msleep(50);
    }
    bt_conn_unref(conn);
    conn_now = NULL;
    k_msleep(200);
}

int hl_encrypt(struct bt_conn *conn)
{
    k_sem_reset(&sec_done);
    const int err = bt_conn_set_security(conn, BT_SECURITY_L2);

    if (err != 0) {
        return err;
    }
    if (k_sem_take(&sec_done, K_SECONDS(10)) != 0) {
        return -ETIMEDOUT;
    }
    return sec_err;
}

/* ---- read by UUID -------------------------------------------------------- */

static K_SEM_DEFINE(read_done, 0, 1);
static uint8_t *read_out;
static size_t read_cap;
static int read_result;

/* Read-by-UUID keeps reading the rest of the handle range after a match
 * and ends with ATTRIBUTE_NOT_FOUND, so stop at the first value. */
static uint8_t on_read(struct bt_conn *conn, uint8_t err, struct bt_gatt_read_params *params,
                       const void *data, uint16_t length)
{
    ARG_UNUSED(conn);
    ARG_UNUSED(params);
    if (err != 0) {
        read_result = -(int)err;
    } else if (data != NULL) {
        read_result = MIN(length, read_cap);
        memcpy(read_out, data, read_result);
    } else {
        read_result = -ENOENT;
    }
    k_sem_give(&read_done);
    return BT_GATT_ITER_STOP;
}

int hl_read(struct bt_conn *conn, uint8_t suffix, uint8_t *out, size_t cap)
{
    static struct bt_uuid_128 uuid;
    static struct bt_gatt_read_params params;
    const uint8_t bytes[16] = {MN_BLE_UUID_BYTES(0)};

    uuid.uuid.type = BT_UUID_TYPE_128;
    memcpy(uuid.val, bytes, 16);
    uuid.val[10] = suffix;
    memset(&params, 0, sizeof(params));
    params.func = on_read;
    params.handle_count = 0;
    params.by_uuid.uuid = &uuid.uuid;
    params.by_uuid.start_handle = BT_ATT_FIRST_ATTRIBUTE_HANDLE;
    params.by_uuid.end_handle = BT_ATT_LAST_ATTRIBUTE_HANDLE;
    read_out = out;
    read_cap = cap;
    read_result = 0;
    k_sem_reset(&read_done);
    const int err = bt_gatt_read(conn, &params);

    if (err != 0) {
        return err;
    }
    TEST_ASSERT(k_sem_take(&read_done, K_SECONDS(10)) == 0, "read timed out");
    return read_result;
}

/* ---- the byte stream ----------------------------------------------------- */

RING_BUF_DECLARE(hl_rx_ring, 16 * 1024);
static struct k_spinlock rx_lock;
static K_SEM_DEFINE(rx_sem, 0, 1);
static size_t rx_total;
static struct mn_framer framer;
static enum hl_transport mode;
static struct bt_conn *stream_conn;
static uint32_t next_req_id = 1;
static uint32_t last_req_id;

static void rx_bytes(const uint8_t *data, size_t len)
{
    k_spinlock_key_t key = k_spin_lock(&rx_lock);
    const uint32_t put = ring_buf_put(&hl_rx_ring, data, len);

    rx_total += len;
    k_spin_unlock(&rx_lock, key);
    TEST_ASSERT(put == len, "host receive ring overflowed");
    k_sem_give(&rx_sem);
}

/* L2CAP */
NET_BUF_POOL_DEFINE(host_pool, 2, BT_L2CAP_SDU_BUF_SIZE(MN_BLE_L2CAP_MTU),
                    CONFIG_BT_CONN_TX_USER_DATA_SIZE, NULL);
static struct bt_l2cap_le_chan chan;
static K_SEM_DEFINE(chan_up, 0, 1);

/* Like a good phone: a 2048-byte MTU and a deep credit window, granted
 * back segment by segment. (Zephyr's default receive path caps the MTU at
 * one PDU and starts at a single credit, which would make this host, not
 * the puck, the bottleneck.) */
#define HOST_CREDITS 32

static void chan_seg_recv(struct bt_l2cap_chan *c, size_t sdu_len, off_t seg_offset,
                          struct net_buf_simple *seg)
{
    ARG_UNUSED(sdu_len);
    ARG_UNUSED(seg_offset);
    rx_bytes(seg->data, seg->len);
    (void)bt_l2cap_chan_give_credits(c, 1);
}

static void chan_connected(struct bt_l2cap_chan *c)
{
    (void)bt_l2cap_chan_give_credits(c, HOST_CREDITS);
    k_sem_give(&chan_up);
}

static void chan_disconnected(struct bt_l2cap_chan *c)
{
    ARG_UNUSED(c);
}

static const struct bt_l2cap_chan_ops chan_ops = {
    .seg_recv = chan_seg_recv,
    .connected = chan_connected,
    .disconnected = chan_disconnected,
};

/* GATT */
static struct bt_gatt_subscribe_params sub;
static struct bt_gatt_discover_params disc;
static uint16_t ctrl_handle;
static uint16_t data_handle;
static K_SEM_DEFINE(disc_done, 0, 1);
static K_SEM_DEFINE(sub_done, 0, 1);

static uint8_t on_notify(struct bt_conn *conn, struct bt_gatt_subscribe_params *params,
                         const void *data, uint16_t length)
{
    ARG_UNUSED(conn);
    ARG_UNUSED(params);
    if (data != NULL) {
        rx_bytes(data, length);
    }
    return BT_GATT_ITER_CONTINUE;
}

static void on_subscribed(struct bt_conn *conn, uint8_t err, struct bt_gatt_subscribe_params *p)
{
    ARG_UNUSED(conn);
    ARG_UNUSED(p);
    TEST_ASSERT(err == 0, "subscribe: %u", err);
    k_sem_give(&sub_done);
}

static uint8_t on_discover(struct bt_conn *conn, const struct bt_gatt_attr *attr,
                           struct bt_gatt_discover_params *params)
{
    ARG_UNUSED(conn);
    ARG_UNUSED(params);
    if (attr == NULL) {
        k_sem_give(&disc_done);
        return BT_GATT_ITER_STOP;
    }
    const struct bt_gatt_chrc *chrc = attr->user_data;
    const uint8_t base[16] = {MN_BLE_UUID_BYTES(0)};
    const struct bt_uuid_128 *u = (const struct bt_uuid_128 *)chrc->uuid;

    if (chrc->uuid->type == BT_UUID_TYPE_128 && memcmp(u->val, base, 10) == 0 &&
        memcmp(&u->val[11], &base[11], 5) == 0) {
        if (u->val[10] == 0x01) {
            ctrl_handle = chrc->value_handle;
        } else if (u->val[10] == 0x02) {
            data_handle = chrc->value_handle;
        }
    }
    return BT_GATT_ITER_CONTINUE;
}

int hl_open(struct bt_conn *conn, enum hl_transport t, uint16_t psm)
{
    k_spinlock_key_t key = k_spin_lock(&rx_lock);

    ring_buf_reset(&hl_rx_ring);
    rx_total = 0;
    k_spin_unlock(&rx_lock, key);
    mn_framer_init(&framer);
    mode = t;
    stream_conn = conn;

    if (t == HL_L2CAP) {
        memset(&chan, 0, sizeof(chan));
        chan.chan.ops = &chan_ops;
        chan.rx.mtu = MN_BLE_L2CAP_MTU;
        chan.rx.mps = BT_L2CAP_RX_MTU;
        k_sem_reset(&chan_up);
        const int err = bt_l2cap_chan_connect(conn, &chan.chan, psm);

        if (err != 0) {
            return err;
        }
        return k_sem_take(&chan_up, K_SECONDS(10)) == 0 ? 0 : -ETIMEDOUT;
    }

    /* GATT: find ctrl and data, then subscribe to data (its CCC follows its
     * value handle). */
    ctrl_handle = 0;
    data_handle = 0;
    memset(&disc, 0, sizeof(disc));
    disc.func = on_discover;
    disc.type = BT_GATT_DISCOVER_CHARACTERISTIC;
    disc.start_handle = BT_ATT_FIRST_ATTRIBUTE_HANDLE;
    disc.end_handle = BT_ATT_LAST_ATTRIBUTE_HANDLE;
    k_sem_reset(&disc_done);
    TEST_ASSERT(bt_gatt_discover(conn, &disc) == 0, "discover");
    TEST_ASSERT(k_sem_take(&disc_done, K_SECONDS(10)) == 0, "discover timed out");
    TEST_ASSERT(ctrl_handle != 0 && data_handle != 0, "ctrl/data not found");
    memset(&sub, 0, sizeof(sub));
    sub.notify = on_notify;
    sub.subscribe = on_subscribed;
    sub.value = BT_GATT_CCC_NOTIFY;
    sub.value_handle = data_handle;
    sub.ccc_handle = data_handle + 1;
    k_sem_reset(&sub_done);
    TEST_ASSERT(bt_gatt_subscribe(conn, &sub) == 0, "subscribe");
    TEST_ASSERT(k_sem_take(&sub_done, K_SECONDS(10)) == 0, "subscribe timed out");
    return 0;
}

static int send_bytes(const uint8_t *data, size_t len)
{
    while (len > 0) {
        if (mode == HL_L2CAP) {
            const size_t n = MIN(len, chan.tx.mtu);
            struct net_buf *buf = net_buf_alloc(&host_pool, K_SECONDS(5));

            TEST_ASSERT(buf != NULL, "host tx buffers");
            net_buf_reserve(buf, BT_L2CAP_SDU_CHAN_SEND_RESERVE);
            net_buf_add_mem(buf, data, n);
            if (bt_l2cap_chan_send(&chan.chan, buf) < 0) {
                net_buf_unref(buf);
                return -EIO;
            }
            data += n;
            len -= n;
        } else {
            const size_t n = MIN(len, bt_gatt_get_mtu(stream_conn) - 3);
            const int err =
                bt_gatt_write_without_response(stream_conn, ctrl_handle, data, (uint16_t)n, false);

            if (err == -ENOMEM) {
                k_msleep(1);
                continue;
            }
            if (err != 0) {
                return err;
            }
            data += n;
            len -= n;
        }
    }
    return 0;
}

int hl_next(micnote_v1_Frame *resp, uint32_t timeout_ms)
{
    static uint8_t buf[512];
    const int64_t deadline = k_uptime_get() + timeout_ms;

    for (;;) {
        const int got = mn_framer_next(&framer, resp);

        TEST_ASSERT(got >= 0, "framing: %d", got);
        if (got == 1) {
            if (resp->req_id == 0) {
                continue; /* unsolicited status */
            }
            TEST_ASSERT(resp->req_id == last_req_id, "response to req %u, want %u", resp->req_id,
                        last_req_id);
            return 0;
        }
        k_spinlock_key_t key = k_spin_lock(&rx_lock);
        const uint32_t n = ring_buf_peek(&hl_rx_ring, buf, sizeof(buf));

        k_spin_unlock(&rx_lock, key);
        if (n > 0) {
            const size_t took = mn_framer_push(&framer, buf, n);

            key = k_spin_lock(&rx_lock);
            ring_buf_get(&hl_rx_ring, NULL, took);
            k_spin_unlock(&rx_lock, key);
            continue;
        }
        const int64_t left = deadline - k_uptime_get();

        if (left <= 0 || k_sem_take(&rx_sem, K_MSEC(left)) != 0) {
            return -ETIMEDOUT;
        }
    }
}

int hl_call(micnote_v1_Frame *req, micnote_v1_Frame *resp, uint32_t timeout_ms)
{
    static uint8_t wire[MN_FRAME_MAX_WIRE];

    req->req_id = next_req_id++;
    last_req_id = req->req_id;
    const int n = mn_frame_encode(req, wire, sizeof(wire));

    TEST_ASSERT(n > 0, "encode: %d", n);
    const int err = send_bytes(wire, (size_t)n);

    if (err != 0) {
        return err;
    }
    return hl_next(resp, timeout_ms);
}

size_t hl_rx_bytes(void)
{
    return rx_total;
}

uint16_t hl_l2cap_tx_mtu(void)
{
    return mode == HL_L2CAP ? chan.tx.mtu : 0;
}

void hl_interval(uint16_t *interval, uint16_t *latency)
{
    *interval = last_interval;
    *latency = last_latency;
}
```

## src/puck.c
```c
/*
 * The puck role: the firmware's BLE module, dispatcher, host slots and
 * recording store, set up as main.c will on the board. Two memos are on the
 * fallback key from before any pairing. Stand-ins for the hardware: the
 * PAIRING window is open while no host is paired, and the button is
 * "pressed" 300 ms after a host confirms.
 */
#include <errno.h>
#include <string.h>

#include <zephyr/fs/fs.h>
#include <zephyr/fs/littlefs.h>
#include <zephyr/kernel.h>
#include <zephyr/settings/settings.h>
#include <zephyr/storage/flash_map.h>

#include <psa/crypto.h>

#include "babblekit/testcase.h"
#include "ble.h"
#include "hosts.h"
#include "keys.h"
#include "recstore.h"
#include "roles.h"

#define MNT "/lfs"
#define DIR MNT "/rec"
#define MEMO_PACKETS 400 /* 8 s of 40-byte packets, about 17 KB */

const uint8_t puck_device_id[8] = {'m', 'n', 'b', 's', 'i', 'm', 0, 1};

FS_LITTLEFS_DECLARE_DEFAULT_CONFIG(lfs_cfg);
static struct fs_mount_t mnt = {
    .type = FS_LITTLEFS,
    .fs_data = &lfs_cfg,
    .storage_dev = (void *)PARTITION_ID(rec_partition),
    .mnt_point = MNT,
};

static struct mn_fallback_key fallback;
static struct mn_rec rec;

static bool pairing_open(void)
{
    return mn_hosts_count() == 0;
}

static void show_sas(const uint8_t sas[MN_SAS_SYMBOLS])
{
    if (sas != NULL) {
        TEST_PRINT("puck: LED shows %u %u %u %u", sas[0], sas[1], sas[2], sas[3]);
    }
}

static struct mn_link_config cfg = {
    .rec_dir = DIR,
    .fallback = &fallback,
    .pairing_open = pairing_open,
    .show_sas = show_sas,
};

static void record_memo(uint64_t id)
{
    static struct mn_rec_params p;
    static struct mn_rec_secrets s;
    uint8_t packet[40];

    memset(&p, 0, sizeof(p));
    p.rec_id = id;
    p.frame_ms = 20;
    p.start_boot = 1;
    p.n_recipients = 1;
    memcpy(p.recipients[0].pub, fallback.pub, 32);
    memcpy(p.recipients[0].host_id, fallback.host_id, 8);
    TEST_ASSERT(mn_rec_secrets_random(&s) == 0, "randomness");
    const int err = mn_rec_open(&rec, DIR, &p, &s);

    TEST_ASSERT(err == 0, "rec open: %d", err);
    for (uint32_t i = 0; i < MEMO_PACKETS; i++) {
        memset(packet, (int)i, sizeof(packet));
        packet[0] = 9 << 3; /* a valid Opus TOC, for the host's sake */
        TEST_ASSERT(mn_rec_append(&rec, packet, sizeof(packet)) == 0, "append");
    }
    TEST_ASSERT(mn_rec_close(&rec) == 0, "rec close");
}

static size_t recordings_left(void)
{
    static struct mn_recstore_info info[4];
    bool more;
    const int n = mn_recstore_list(DIR, 0, info, ARRAY_SIZE(info), &more);

    TEST_ASSERT(n >= 0, "list: %d", n);
    return (size_t)n;
}

void puck_main(void)
{
    const struct mn_ble_status status = {
        .battery_pct = 80,
        .state = micnote_v1_DeviceState_DEVICE_STATE_IDLE,
        .recording_count = 2,
        .flags = MN_BLE_STATUS_SYNC_PENDING,
    };

    TEST_ASSERT(psa_crypto_init() == PSA_SUCCESS, "psa");
    TEST_ASSERT(settings_subsys_init() == 0, "settings");
    TEST_ASSERT(fs_mount(&mnt) == 0, "mount");
    TEST_ASSERT(mn_recstore_init(DIR) == 0, "recstore");
    TEST_ASSERT(mn_hosts_init() == 0, "hosts");
    TEST_ASSERT(mn_keys_fallback(&fallback) >= 0, "fallback key");
    record_memo(0x0000000100000001ULL);
    record_memo(0x0000000100000002ULL);

    cfg.device_info.proto_version = 1;
    memcpy(cfg.device_info.device_id, puck_device_id, 8);
    strcpy(cfg.device_info.board, "nrf52_bsim");
    TEST_ASSERT(mn_ble_init(&cfg) == 0, "ble init");
    mn_ble_status_set(&status);
    TEST_ASSERT(mn_ble_advertise(MN_ADV_FAST, true) == 0, "advertise");
    TEST_PRINT("puck: advertising, psm 0x%04x", mn_ble_psm());

    bool was_connected = false;
    int64_t confirm_since = -1;
    bool passed = false;

    for (;;) {
        k_msleep(20);
        const bool connected = mn_ble_connected();

        if (was_connected && !connected) {
            /* As main.c will after a sync: slow advertising, so the host
             * can come back; FAST again for the next test step. */
            (void)mn_ble_advertise(MN_ADV_FAST, recordings_left() > 0);
        }
        was_connected = connected;

        if (mn_ble_confirm_pending()) {
            if (confirm_since < 0) {
                confirm_since = k_uptime_get();
            } else if (k_uptime_get() - confirm_since >= 300) {
                TEST_PRINT("puck: button pressed");
                mn_ble_pair_press();
                confirm_since = -1;
            }
        } else {
            confirm_since = -1;
        }

        if (!passed && mn_hosts_count() == 1 && recordings_left() == 0) {
            passed = true;
            TEST_PASS("puck: paired one host, everything synced and acked");
        }
    }
}
```

## src/roles.h
```c
/* The three roles in this BabbleSim test, and the host side's helpers. */
#ifndef MICNOTE_BSIM_LINK_ROLES_H_
#define MICNOTE_BSIM_LINK_ROLES_H_

#include <stdbool.h>
#include <stddef.h>
#include <stdint.h>

#include <zephyr/bluetooth/conn.h>

#include "micnote.pb.h"

void puck_main(void);
void host_main(void);
void stranger_main(void);

/* The puck's fixed device_id, as in DeviceInfo. */
extern const uint8_t puck_device_id[8];

/* ---- host_link.c: a central speaking the protocol ----------------------- */

/* Scans for a puck advertising the Micnote service and connects. Returns the
 * connection (a ref), and *sync_pending from its advertising. */
struct bt_conn *hl_connect(bool *sync_pending);
void hl_disconnect(struct bt_conn *conn);

/* Asks for an encrypted link; returns 0 or the security error. */
int hl_encrypt(struct bt_conn *conn);

/* Reads a characteristic of the service by UUID suffix (1 ctrl ... 4
 * status); returns the length read, or a negative ATT error / errno. */
int hl_read(struct bt_conn *conn, uint8_t suffix, uint8_t *out, size_t cap);

enum hl_transport { HL_L2CAP, HL_GATT };

/* Opens the byte stream: the L2CAP channel on `psm`, or GATT (subscribe to
 * data, write to ctrl). */
int hl_open(struct bt_conn *conn, enum hl_transport t, uint16_t psm);

/* Sends a request (req_id is filled in) and waits up to timeout_ms for the
 * next frame answering it; returns 0 with *resp, or -ETIMEDOUT. */
int hl_call(micnote_v1_Frame *req, micnote_v1_Frame *resp, uint32_t timeout_ms);
/* The next frame answering the last request (for Fetch's Chunk stream). */
int hl_next(micnote_v1_Frame *resp, uint32_t timeout_ms);
/* Bytes received since the stream opened. */
size_t hl_rx_bytes(void);
/* The last connection parameters the puck asked for and got (units of
 * 1.25 ms), 0 if none yet. */
void hl_interval(uint16_t *interval, uint16_t *latency);
/* The L2CAP channel's negotiated send MTU, or 0. */
uint16_t hl_l2cap_tx_mtu(void);

#endif /* MICNOTE_BSIM_LINK_ROLES_H_ */
```

## src/stranger.c
```c
/*
 * The stranger role: a central that turns up after the host has paired
 * (the pairing window is shut). It must not get a bond, nor read anything,
 * nor open the L2CAP channel.
 */
#include <errno.h>

#include <zephyr/bluetooth/att.h>
#include <zephyr/bluetooth/bluetooth.h>
#include <zephyr/kernel.h>
#include <zephyr/settings/settings.h>

#include "babblekit/testcase.h"
#include "roles.h"

void stranger_main(void)
{
    bool pending;
    uint8_t v[8];

    /* Bonds and the identity address live in settings (CONFIG_BT_SETTINGS). */
    TEST_ASSERT(settings_subsys_init() == 0, "settings");
    TEST_ASSERT(bt_enable(NULL) == 0, "bt");
    TEST_ASSERT(settings_load() == 0, "settings load");
    /* Let the host pair and sync first. */
    k_sleep(K_SECONDS(40));

    struct bt_conn *conn = hl_connect(&pending);
    const int r = hl_read(conn, 0x03, v, sizeof(v));

    TEST_ASSERT(r == -BT_ATT_ERR_AUTHENTICATION || r == -BT_ATT_ERR_INSUFFICIENT_ENCRYPTION,
                "psm readable without encryption: %d", r);
    const int sec = hl_encrypt(conn);

    TEST_ASSERT(sec != 0, "a stranger got a bond outside the pairing window");
    TEST_PRINT("stranger: bonding refused (%d), reads refused (%d)", sec, r);
    hl_disconnect(conn);
    TEST_PASS("stranger: kept out");
}
```
