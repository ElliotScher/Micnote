## CMakeLists.txt
```
cmake_minimum_required(VERSION 3.20.0)
find_package(Zephyr REQUIRED HINTS $ENV{ZEPHYR_BASE})
project(micnote_audio_test)

set(MICNOTE_APP_SRC ${CMAKE_CURRENT_SOURCE_DIR}/../../app/src)

target_include_directories(app PRIVATE ${MICNOTE_APP_SRC}/audio ${CMAKE_CURRENT_SOURCE_DIR}/../common)
target_sources(app PRIVATE
  src/preproc.c
  src/encoder.c
  src/pipeline.c
  ${MICNOTE_APP_SRC}/audio/preproc.c
  ${MICNOTE_APP_SRC}/audio/encoder.c
  ${MICNOTE_APP_SRC}/audio/pipeline.c
)
```

## prj.conf
```kconfig
CONFIG_ZTEST=y
CONFIG_OPUS=y
CONFIG_CRC=y
# The encoder suite calls opus_encode() on the ztest thread.
CONFIG_ZTEST_STACK_SIZE=32768
```

## src/encoder.c
```c
#include "encoder.h"

#include <errno.h>
#include <string.h>

#include <zephyr/sys/crc.h>
#include <zephyr/ztest.h>

#include "voice.h"

/* Same input and settings as tests/opus, whose packet stream has this
 * CRC-32. Pushed in any block size, the encoder must give the same packets. */
#define FRAMES 150
#define SAMPLES (MN_ENC_FRAME_SAMPLES * FRAMES)
#define OPUS_SUITE_CRC 0x21f1f4c2u

static struct mn_enc enc;
static int16_t voice[SAMPLES];

struct collect {
    uint32_t crc;
    uint32_t packets;
    uint32_t fail_at; /* return -ENOSPC for this packet (1-based); 0 never */
};

static int collect_sink(void *ctx, const uint8_t *packet, size_t len)
{
    struct collect *c = ctx;
    const uint8_t len_le[2] = {(uint8_t)len, (uint8_t)(len >> 8)};

    if (++c->packets == c->fail_at) {
        return -ENOSPC;
    }
    zassert_true(len > 0 && len <= MN_ENC_MAX_PACKET);
    c->crc = crc32_ieee_update(c->crc, len_le, sizeof(len_le));
    c->crc = crc32_ieee_update(c->crc, packet, len);
    return 0;
}

static void encode_in_blocks(size_t block, struct collect *c)
{
    memset(c, 0, sizeof(*c));
    zassert_ok(mn_enc_init(&enc, MN_ENC_COMPLEXITY_DEFAULT, collect_sink, c));
    for (size_t i = 0; i < SAMPLES; i += block) {
        zassert_ok(mn_enc_push(&enc, &voice[i], MIN(block, SAMPLES - i)));
    }
    zassert_ok(mn_enc_flush(&enc));
}

static void *setup(void)
{
    mn_voice(voice, SAMPLES);
    return NULL;
}

ZTEST(encoder, test_10ms_blocks_match_opus_suite)
{
    struct collect c;

    encode_in_blocks(MN_ENC_FRAME_SAMPLES / 2, &c);
    zassert_equal(c.packets, FRAMES);
    zassert_equal(enc.packets, FRAMES);
    zassert_equal(c.crc, OPUS_SUITE_CRC, "CRC-32 0x%08x", c.crc);
}

ZTEST(encoder, test_odd_blocks_match_opus_suite)
{
    struct collect c;

    /* 7 doesn't divide 320: frames fill across push boundaries. */
    encode_in_blocks(7, &c);
    zassert_equal(c.packets, FRAMES);
    zassert_equal(c.crc, OPUS_SUITE_CRC, "CRC-32 0x%08x", c.crc);

    encode_in_blocks(SAMPLES, &c);
    zassert_equal(c.crc, OPUS_SUITE_CRC, "CRC-32 0x%08x", c.crc);
}

ZTEST(encoder, test_flush_pads_partial_frame)
{
    struct collect c = {0};

    zassert_ok(mn_enc_init(&enc, MN_ENC_COMPLEXITY_DEFAULT, collect_sink, &c));
    zassert_ok(mn_enc_push(&enc, voice, MN_ENC_FRAME_SAMPLES + 10));
    zassert_equal(c.packets, 1);
    zassert_ok(mn_enc_flush(&enc));
    zassert_equal(c.packets, 2);
    /* Nothing left: a second flush encodes nothing. */
    zassert_ok(mn_enc_flush(&enc));
    zassert_equal(c.packets, 2);
}

ZTEST(encoder, test_flush_on_frame_boundary)
{
    struct collect c = {0};

    zassert_ok(mn_enc_init(&enc, MN_ENC_COMPLEXITY_DEFAULT, collect_sink, &c));
    zassert_ok(mn_enc_flush(&enc));
    zassert_equal(c.packets, 0);
    zassert_ok(mn_enc_push(&enc, voice, 2 * MN_ENC_FRAME_SAMPLES));
    zassert_ok(mn_enc_flush(&enc));
    zassert_equal(c.packets, 2);
}

ZTEST(encoder, test_position)
{
    struct collect c = {0};

    zassert_ok(mn_enc_init(&enc, MN_ENC_COMPLEXITY_DEFAULT, collect_sink, &c));
    zassert_equal(mn_enc_position_ms(&enc), 0);
    zassert_ok(mn_enc_push(&enc, voice, 330)); /* 20.6 ms */
    zassert_equal(mn_enc_position_ms(&enc), 20);
    zassert_ok(mn_enc_push(&enc, voice, 16000 - 330));
    zassert_equal(mn_enc_position_ms(&enc), 1000);
}

ZTEST(encoder, test_sink_error_sticks)
{
    struct collect c = {.fail_at = 3};

    zassert_ok(mn_enc_init(&enc, MN_ENC_COMPLEXITY_DEFAULT, collect_sink, &c));
    zassert_equal(mn_enc_push(&enc, voice, 5 * MN_ENC_FRAME_SAMPLES), -ENOSPC);
    /* It stopped at the failing packet... */
    zassert_equal(c.packets, 3);
    zassert_equal(enc.packets, 2);
    /* ...and stays stopped. */
    zassert_equal(mn_enc_push(&enc, voice, MN_ENC_FRAME_SAMPLES), -ENOSPC);
    zassert_equal(mn_enc_flush(&enc), -ENOSPC);
    zassert_equal(c.packets, 3);
}

ZTEST(encoder, test_init_checks)
{
    struct collect c = {0};

    zassert_equal(mn_enc_init(&enc, -1, collect_sink, &c), -EINVAL);
    zassert_equal(mn_enc_init(&enc, 11, collect_sink, &c), -EINVAL);
    zassert_equal(mn_enc_init(&enc, 3, NULL, &c), -EINVAL);
    for (int cx = 0; cx <= 10; cx++) {
        zassert_ok(mn_enc_init(&enc, cx, collect_sink, &c));
    }
}

ZTEST_SUITE(encoder, NULL, setup, NULL, NULL, NULL);
```

## src/pipeline.c
```c
/*
 * The encoder thread with a fake capture source: stereo 10 ms blocks of the
 * test voice, with -EAGAIN gaps like a DMIC read timing out, then the end of
 * the input or a fault.
 */
#include "pipeline.h"

#include <errno.h>
#include <string.h>

#include <zephyr/kernel.h>
#include <zephyr/ztest.h>

#include "preproc.h"
#include "voice.h"

#define BLOCKS 100 /* 1 s */

static int16_t voice[BLOCKS * MN_AUDIO_BLOCK_FRAMES];
static int16_t block[MN_AUDIO_BLOCK_FRAMES * 2];

struct fake {
    uint32_t reads; /* blocks handed out */
    uint32_t released;
    uint32_t calls;
    uint32_t end_after; /* -ENODATA (or `fault`) once this many were read */
    int fault;          /* 0: -ENODATA at the end; else this error */
    bool forever;       /* never end; -EAGAIN after end_after */
    bool outstanding;
};

static struct fake fake;

static int fake_read(void *ctx, int16_t **buf)
{
    struct fake *f = ctx;

    zassert_false(f->outstanding, "read before the last block was released");
    if (++f->calls % 3 == 0) {
        k_msleep(1);
        return -EAGAIN;
    }
    if (f->reads == f->end_after) {
        if (f->forever) {
            k_msleep(1);
            return -EAGAIN;
        }
        return f->fault ? f->fault : -ENODATA;
    }
    for (size_t i = 0; i < MN_AUDIO_BLOCK_FRAMES; i++) {
        int16_t s = voice[(f->reads % BLOCKS) * MN_AUDIO_BLOCK_FRAMES + i];

        block[2 * i] = s;
        block[2 * i + 1] = s;
    }
    f->reads++;
    f->outstanding = true;
    *buf = block;
    return 0;
}

static void fake_release(void *ctx, int16_t *buf)
{
    struct fake *f = ctx;

    zassert_equal_ptr(buf, block);
    f->outstanding = false;
    f->released++;
}

static const struct mn_audio_source src = {
    .read = fake_read,
    .release = fake_release,
    .ctx = &fake,
    .channels = 2,
};

struct sink {
    uint32_t packets;
    uint32_t bytes;
    uint32_t fail_at;
};

static struct sink sink;

static int count_sink(void *ctx, const uint8_t *packet, size_t len)
{
    struct sink *s = ctx;

    ARG_UNUSED(packet);
    if (++s->packets == s->fail_at) {
        return -ENOSPC;
    }
    s->bytes += len;
    return 0;
}

static const struct mn_audio_config cfg = {
    .gain_q8 = MN_PREPROC_GAIN_UNITY,
    .complexity = MN_ENC_COMPLEXITY_DEFAULT,
    .sink = count_sink,
    .sink_ctx = &sink,
};

static void *setup(void)
{
    mn_voice(voice, ARRAY_SIZE(voice));
    return NULL;
}

static void before(void *f)
{
    ARG_UNUSED(f);
    memset(&fake, 0, sizeof(fake));
    memset(&sink, 0, sizeof(sink));
    /* Collect a thread a failed test left behind. */
    (void)mn_audio_stop();
}

/* Waits for the thread to finish reading, without asking it to stop. */
static void wait_reads(uint32_t n)
{
    for (int i = 0; i < 5000 && (fake.reads < n || fake.outstanding); i++) {
        k_msleep(1);
    }
    zassert_equal(fake.reads, n);
}

ZTEST(pipeline, test_encodes_until_source_ends)
{
    fake.end_after = BLOCKS + 1; /* 1.01 s: the last frame is half full */
    zassert_ok(mn_audio_start(&src, &cfg));
    wait_reads(BLOCKS + 1);
    zassert_ok(mn_audio_stop());

    zassert_equal(fake.released, fake.reads);
    zassert_equal(mn_audio_blocks(), BLOCKS + 1);
    zassert_equal(mn_audio_position_ms(), (BLOCKS + 1) * MN_AUDIO_BLOCK_MS);
    /* 50 whole frames, and the flush pads the half one. */
    zassert_equal(sink.packets, BLOCKS / 2 + 1);
    TC_PRINT("%u packets, %u bytes\n", sink.packets, sink.bytes);
}

/* A stop straight after the start may beat the thread to its first read
 * (it runs at a lower priority than this one); wait lets it run to the end. */
ZTEST(pipeline, test_wait_runs_to_the_end)
{
    fake.end_after = 7;
    zassert_ok(mn_audio_start(&src, &cfg));
    zassert_false(mn_audio_done());
    for (int i = 0; i < 5000 && !mn_audio_done(); i++) {
        k_msleep(1);
    }
    zassert_true(mn_audio_done());
    zassert_ok(mn_audio_wait());
    zassert_false(mn_audio_done());
    zassert_equal(fake.reads, 7);
    zassert_equal(fake.released, 7);
    zassert_equal(sink.packets, 4); /* 3 whole frames and the padded half */
    zassert_equal(mn_audio_wait(), -EALREADY);
}

ZTEST(pipeline, test_stop_while_running)
{
    fake.end_after = 10;
    fake.forever = true;
    zassert_ok(mn_audio_start(&src, &cfg));
    wait_reads(10);
    zassert_ok(mn_audio_stop());
    zassert_equal(fake.released, 10);
    zassert_equal(sink.packets, 5);
}

ZTEST(pipeline, test_source_fault_ends_recording)
{
    fake.end_after = 5;
    fake.fault = -EIO;
    zassert_ok(mn_audio_start(&src, &cfg));
    wait_reads(5);
    zassert_equal(mn_audio_stop(), -EIO);
    zassert_equal(fake.released, 5);
    /* No flush after a fault. */
    zassert_equal(sink.packets, 2);
}

ZTEST(pipeline, test_sink_error_ends_recording)
{
    fake.end_after = BLOCKS;
    sink.fail_at = 3;
    zassert_ok(mn_audio_start(&src, &cfg));
    /* The thread ends by itself at the failing packet. */
    zassert_equal(mn_audio_wait(), -ENOSPC);
    zassert_equal(sink.packets, 3);
    zassert_equal(fake.released, fake.reads);
}

ZTEST(pipeline, test_one_at_a_time)
{
    fake.end_after = 1;
    fake.forever = true;
    zassert_ok(mn_audio_start(&src, &cfg));
    zassert_equal(mn_audio_start(&src, &cfg), -EBUSY);
    zassert_ok(mn_audio_stop());
    zassert_equal(mn_audio_stop(), -EALREADY);
    /* And a new one can start after the stop. */
    memset(&fake, 0, sizeof(fake));
    fake.end_after = 2;
    zassert_ok(mn_audio_start(&src, &cfg));
    wait_reads(2);
    zassert_ok(mn_audio_stop());
}

ZTEST(pipeline, test_bad_arguments)
{
    struct mn_audio_source mono3 = src;

    mono3.channels = 3;
    zassert_equal(mn_audio_start(&mono3, &cfg), -EINVAL);
    zassert_equal(mn_audio_start(NULL, &cfg), -EINVAL);
    zassert_equal(mn_audio_start(&src, NULL), -EINVAL);

    struct mn_audio_config bad = cfg;

    bad.complexity = 42;
    zassert_equal(mn_audio_start(&src, &bad), -EINVAL);
    /* A failed start leaves nothing running. */
    zassert_equal(mn_audio_stop(), -EALREADY);
}

ZTEST_SUITE(pipeline, NULL, setup, before, NULL, NULL);
```

## src/preproc.c
```c
#include "preproc.h"

#include <stdlib.h>

#include <zephyr/ztest.h>

#include "voice.h"

#define RATE 16000

static struct mn_preproc p;
static int16_t in[2 * RATE];
static int16_t out[RATE];

/* n samples of a sine at freq_hz with the given peak, in channel ch of
 * `channels` (the other channel, if any, gets the same). */
static void sine(int16_t *buf, size_t n, uint8_t channels, int32_t freq_hz, int32_t peak)
{
    uint32_t phase = 0;
    const uint32_t step = (uint32_t)(((uint64_t)freq_hz << 32) / RATE);

    for (size_t i = 0; i < n; i++) {
        int16_t s = (int16_t)((mn_sine_q15(phase) * peak) >> 15);

        for (uint8_t c = 0; c < channels; c++) {
            buf[i * channels + c] = s;
        }
        phase += step;
    }
}

/* Peak of |out| over the last half of n samples, after the filter settled. */
static int32_t settled_peak(size_t n)
{
    int32_t peak = 0;

    for (size_t i = n / 2; i < n; i++) {
        peak = MAX(peak, abs(out[i]));
    }
    return peak;
}

ZTEST(preproc, test_stereo_mixes_to_mean)
{
    const int16_t lr[] = {1000, 3000, -32768, -32768, 32767, 32767};

    mn_preproc_init(&p, MN_PREPROC_GAIN_UNITY);
    mn_preproc_run(&p, lr, 1, 2, out);
    /* The filter's first output is its first input. */
    zassert_equal(out[0], 2000);

    /* Full-scale samples of the same sign don't overflow the mix. */
    mn_preproc_init(&p, MN_PREPROC_GAIN_UNITY);
    mn_preproc_run(&p, &lr[2], 1, 2, out);
    zassert_equal(out[0], -32768);
    mn_preproc_init(&p, MN_PREPROC_GAIN_UNITY);
    mn_preproc_run(&p, &lr[4], 1, 2, out);
    zassert_equal(out[0], 32767);
}

ZTEST(preproc, test_removes_dc)
{
    for (size_t i = 0; i < RATE; i++) {
        in[i] = 10000;
    }
    mn_preproc_init(&p, MN_PREPROC_GAIN_UNITY);
    mn_preproc_run(&p, in, RATE, 1, out);
    /* The time constant is 1/(2*pi*80) = 2 ms; after 1 s nothing is left. */
    for (size_t i = RATE - 100; i < RATE; i++) {
        zassert_true(abs(out[i]) <= 1, "out[%zu] = %d", i, out[i]);
    }
}

ZTEST(preproc, test_passes_voice_band)
{
    sine(in, RATE, 1, 1000, 16000);
    mn_preproc_init(&p, MN_PREPROC_GAIN_UNITY);
    mn_preproc_run(&p, in, RATE, 1, out);
    /* 1 kHz is 0.997 of the way through an 80 Hz one-pole high-pass. */
    zassert_within(settled_peak(RATE), 16000, 16000 / 50, "%d", settled_peak(RATE));
}

ZTEST(preproc, test_cuts_rumble)
{
    sine(in, RATE, 1, 20, 16000);
    mn_preproc_init(&p, MN_PREPROC_GAIN_UNITY);
    mn_preproc_run(&p, in, RATE, 1, out);
    /* 20 Hz: 20 / sqrt(20^2 + 80^2) = 0.24. */
    zassert_within(settled_peak(RATE), 16000 * 24 / 100, 16000 / 20, "%d", settled_peak(RATE));
}

ZTEST(preproc, test_gain)
{
    sine(in, RATE, 2, 1000, 8000);
    mn_preproc_init(&p, 2 * MN_PREPROC_GAIN_UNITY);
    mn_preproc_run(&p, in, RATE, 2, out);
    zassert_within(settled_peak(RATE), 16000, 16000 / 50, "%d", settled_peak(RATE));
}

ZTEST(preproc, test_gain_saturates)
{
    static int16_t ref[RATE];

    sine(in, RATE, 1, 1000, 16000);
    mn_preproc_init(&p, MN_PREPROC_GAIN_UNITY);
    mn_preproc_run(&p, in, RATE, 1, ref);
    mn_preproc_init(&p, 16 * MN_PREPROC_GAIN_UNITY);
    mn_preproc_run(&p, in, RATE, 1, out);

    /* Wherever 16x the unity output is far out of range, the sample is
     * clipped to the rail on the same side, never wrapped to the other. */
    for (size_t i = 0; i < RATE; i++) {
        if (ref[i] > 2100) {
            zassert_equal(out[i], INT16_MAX, "out[%zu] = %d", i, out[i]);
        } else if (ref[i] < -2100) {
            zassert_equal(out[i], INT16_MIN, "out[%zu] = %d", i, out[i]);
        }
    }
}

ZTEST(preproc, test_in_place)
{
    mn_voice(in, RATE);
    mn_preproc_init(&p, MN_PREPROC_GAIN_UNITY);
    mn_preproc_run(&p, in, RATE, 1, out);

    mn_preproc_init(&p, MN_PREPROC_GAIN_UNITY);
    mn_preproc_run(&p, in, RATE, 1, in);
    zassert_mem_equal(in, out, RATE * sizeof(int16_t));
}

ZTEST_SUITE(preproc, NULL, NULL, NULL, NULL, NULL);
```
