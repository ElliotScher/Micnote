## CMakeLists.txt
```
cmake_minimum_required(VERSION 3.20.0)
find_package(Zephyr REQUIRED HINTS $ENV{ZEPHYR_BASE})
project(micnote_firmware)

target_sources(app PRIVATE src/main.c)
```

## sysbuild.conf
```
SB_CONFIG_BOOTLOADER_MCUBOOT=y
# NCS 3.4 deprecated Partition Manager; the Thingy:53's net-core DTS has no
# s0_partition, so its default net-core bootloader (b0n) can't be laid out.
SB_CONFIG_SECURE_BOOT_NETCORE=n
```

## prj.conf
```kconfig
CONFIG_LOG=y
CONFIG_USE_SEGGER_RTT=y
CONFIG_LOG_BACKEND_RTT=y
CONFIG_LOG_BACKEND_UART=y
CONFIG_GPIO=y
CONFIG_ASSERT=y
CONFIG_NCS_APPLICATION_BOOT_BANNER_STRING="Micnote"
```

## release.conf
```kconfig
CONFIG_LOG_BACKEND_UART=n
CONFIG_ASSERT=n
CONFIG_SERIAL=n
CONFIG_CONSOLE=n
```

## src/main.c
```c
#include <zephyr/app_version.h>
#include <zephyr/drivers/gpio.h>
#include <zephyr/kernel.h>
#include <zephyr/logging/log.h>

LOG_MODULE_REGISTER(micnote_firmware, LOG_LEVEL_INF);

// 1 second sleep time
#define SLEEP_TIME_MS 1000

// The device tree node identifier for the led0 alias.
#define LED0_NODE DT_ALIAS(led0)

static const struct gpio_dt_spec led = GPIO_DT_SPEC_GET(LED0_NODE, gpios);

int main(void)
{
    LOG_INF("Micnote %s", APP_VERSION_STRING);

    int ret;
    bool led_state = true;

    if (!gpio_is_ready_dt(&led)) {
        LOG_ERR("LED0 Not Ready");
        return 1;
    }

    ret = gpio_pin_configure_dt(&led, GPIO_OUTPUT_ACTIVE);
    if (ret < 0) {
        LOG_ERR("Failed to configure LED0: %d", ret);
        return 1;
    }

    while (true) {
        ret = gpio_pin_toggle_dt(&led);
        if (ret < 0) {
            LOG_ERR("Failed to toggle LED0: %d", ret);
            return 1;
        }

        led_state = !led_state;
        LOG_INF("LED State: %d", led_state);
        k_msleep(SLEEP_TIME_MS);
    }
    return 0;
}
```

## src/recorder.c
```c
#include "recorder.h"

#include <errno.h>
#include <string.h>

#include <zephyr/kernel.h>
#include <zephyr/sys/atomic.h>
#include <zephyr/sys/byteorder.h>
#include <zephyr/sys/ring_buffer.h>

/* Ring records: kind u8 | pad u8 | len u16 LE | payload[len]. */
enum { REC_PACKET = 1, REC_MARKER = 2, REC_CLOSE = 3 };
#define REC_HDR 4
#define STORAGE_STACK_SIZE 4096

static struct mn_recorder_config config;
static struct mn_rec rec;

RING_BUF_DECLARE(ring, MN_RECORDER_RING_SIZE);
static struct k_spinlock ring_lock;
static K_SEM_DEFINE(work, 0, K_SEM_MAX_LIMIT);
static K_SEM_DEFINE(closed, 0, 1);

K_THREAD_STACK_DEFINE(storage_stack, STORAGE_STACK_SIZE);
static struct k_thread storage_thread;

static bool active;
static atomic_t storage_err; /* first recstore error of this recording */
static int close_err;

/* ---- the ring ---------------------------------------------------------- */

/* Puts one whole record, or nothing: -ENOBUFS if it doesn't fit. Called by
 * the encoder thread (packets) and the caller's thread (markers, close). */
static int ring_put(uint8_t kind, const uint8_t *payload, uint16_t len)
{
    uint8_t hdr[REC_HDR] = {kind, 0};
    int rc = 0;

    sys_put_le16(len, &hdr[2]);
    k_spinlock_key_t key = k_spin_lock(&ring_lock);

    if (ring_buf_space_get(&ring) < REC_HDR + (uint32_t)len) {
        rc = -ENOBUFS;
    } else {
        ring_buf_put(&ring, hdr, REC_HDR);
        ring_buf_put(&ring, payload, len);
    }
    k_spin_unlock(&ring_lock, key);
    if (rc == 0) {
        k_sem_give(&work);
    }
    return rc;
}

/* Takes the next record into buf (at least MN_ENC_MAX_PACKET bytes). False
 * when the ring is empty. */
static bool ring_get(uint8_t *kind, uint8_t *buf, uint16_t *len)
{
    uint8_t hdr[REC_HDR];
    bool got = false;
    k_spinlock_key_t key = k_spin_lock(&ring_lock);

    if (ring_buf_get(&ring, hdr, REC_HDR) == REC_HDR) {
        *kind = hdr[0];
        *len = sys_get_le16(&hdr[2]);
        ring_buf_get(&ring, buf, *len);
        got = true;
    }
    k_spin_unlock(&ring_lock, key);
    return got;
}

/* ---- the storage thread ------------------------------------------------ */

static void storage_main(void *a, void *b, void *c)
{
    ARG_UNUSED(a);
    ARG_UNUSED(b);
    ARG_UNUSED(c);
    static uint8_t buf[MN_ENC_MAX_PACKET];

    for (;;) {
        uint8_t kind = 0;
        uint16_t len = 0;

        k_sem_take(&work, K_FOREVER);
        while (ring_get(&kind, buf, &len)) {
            int rc = 0;

            if (kind == REC_CLOSE) {
                close_err = mn_rec_close(&rec);
                k_sem_give(&closed);
                continue;
            }
            if (atomic_get(&storage_err) != 0) {
                continue; /* the recording is failing: drop until the close */
            }
            if (kind == REC_PACKET) {
                rc = mn_rec_append(&rec, buf, len);
            } else {
                rc = mn_rec_marker(&rec, buf[0], sys_get_le32(&buf[1]));
            }
            if (rc < 0) {
                atomic_cas(&storage_err, 0, rc);
            }
        }
    }
}

/* The encoder thread's sink. */
static int ring_sink(void *ctx, const uint8_t *packet, size_t len)
{
    ARG_UNUSED(ctx);
    int err = (int)atomic_get(&storage_err);

    /* A storage error ends the recording through the encoder, which
     * mn_recorder_poll() then sees. */
    return err != 0 ? err : ring_put(REC_PACKET, packet, (uint16_t)len);
}

/* ---- the API ----------------------------------------------------------- */

int mn_recorder_init(const struct mn_recorder_config *cfg)
{
    if (cfg == NULL || cfg->dir == NULL) {
        return -EINVAL;
    }
    config = *cfg;
    k_thread_create(&storage_thread, storage_stack, K_THREAD_STACK_SIZEOF(storage_stack),
                    storage_main, NULL, NULL, NULL, MN_RECORDER_STORAGE_PRIORITY, 0, K_NO_WAIT);
    k_thread_name_set(&storage_thread, "storage");
    return 0;
}

int mn_recorder_start(const struct mn_rec_params *p, enum mn_storage_state storage,
                      uint8_t battery_pct)
{
    static struct mn_rec_secrets secrets;
    const struct mn_audio_config audio = {
        .gain_q8 = config.gain_q8,
        .complexity = config.complexity,
        .sink = ring_sink,
        .sink_ctx = NULL,
    };

    if (active) {
        return -EBUSY;
    }
    if (storage == MN_STORAGE_FULL) {
        return -ENOSPC;
    }
    if (mn_policy_battery_low(battery_pct)) {
        return -EPERM;
    }

    int rc = mn_rec_secrets_random(&secrets);

    if (rc == 0) {
        rc = mn_rec_open(&rec, config.dir, p, &secrets);
    }
    if (rc < 0) {
        return rc;
    }
    atomic_set(&storage_err, 0);
    rc = mn_audio_start(&config.source, &audio);
    if (rc < 0) {
        /* Nothing was recorded; close it so it isn't left as a .part. */
        (void)mn_rec_close(&rec);
        return rc;
    }
    active = true;
    return 0;
}

/* Collects the encoder thread (asking it to stop or not), lets the storage
 * thread write everything before the close, and closes. */
static int finish(bool ask_to_stop)
{
    int audio_err = ask_to_stop ? mn_audio_stop() : mn_audio_wait();

    /* The close has to follow every packet: wait for room if need be. */
    while (ring_put(REC_CLOSE, NULL, 0) == -ENOBUFS) {
        k_msleep(1);
    }
    k_sem_take(&closed, K_FOREVER);
    active = false;

    int storage = (int)atomic_get(&storage_err);

    /* The storage error is the cause when the encoder stopped because of
     * it (it returns the sink's error). */
    if (storage != 0) {
        return storage;
    }
    return audio_err != 0 ? audio_err : close_err;
}

int mn_recorder_stop(void)
{
    if (!active) {
        return -EALREADY;
    }
    return finish(true);
}

int mn_recorder_marker(uint8_t type)
{
    uint8_t m[5] = {type};

    if (!active) {
        return -EALREADY;
    }
    sys_put_le32(mn_audio_position_ms(), &m[1]);
    return ring_put(REC_MARKER, m, sizeof(m));
}

enum mn_recorder_end mn_recorder_poll(enum mn_storage_state storage, uint8_t battery_pct, int *err)
{
    enum mn_recorder_end why = MN_REC_END_NONE;
    int rc = 0;

    if (!active) {
        /* nothing to do */
    } else if (mn_audio_done()) {
        rc = finish(false);
        /* Ended with no error: the source ran out (tests, the simulator). */
        why = rc != 0 ? MN_REC_END_FAULT : MN_REC_END_USER;
    } else if (mn_policy_battery_low(battery_pct)) {
        rc = finish(true);
        why = MN_REC_END_LOW_BATTERY;
    } else if (storage == MN_STORAGE_FULL) {
        rc = finish(true);
        why = MN_REC_END_STORAGE_FULL;
    }
    if (err != NULL) {
        *err = rc;
    }
    return why;
}

bool mn_recorder_active(void)
{
    return active;
}

uint64_t mn_recorder_rec_id(void)
{
    return active ? rec.rec_id : 0;
}
```

## src/recorder.h
```c
/*
 * The recorder: one recording from start to stop (stage 1 §4.1, §4.2, §4.9).
 *
 *   capture source -> encoder thread (prio 5, audio/pipeline.c)
 *     -> ring buffer -> storage thread (prio 6) -> recstore -> flash
 *
 * The encoder thread never writes flash: its sink puts each packet in a ring
 * buffer, and the storage thread appends from there. A LittleFS block erase
 * or a sync can take tens of ms, longer than the capture's 80 ms of slack
 * when two come together; the ring holds about 4 s of audio. Markers go
 * through the same ring, so they land in the stream exactly where they were
 * placed.
 *
 * The policy (§4.9) is applied here: mn_recorder_start() refuses when
 * storage is full or the battery is under 5%, and mn_recorder_poll()
 * finalizes the active recording when either becomes true while recording,
 * or when the encoder thread ended on its own (a capture or storage fault).
 * A finalized recording is closed normally, with its trailer, so the host
 * sees the audio up to that point.
 *
 * The mn_recorder_* functions are for one caller thread (main's state
 * machine); they aren't safe to call concurrently with each other.
 * psa_crypto_init() and mn_recstore_init() must have run first.
 */
#ifndef MICNOTE_RECORDER_H_
#define MICNOTE_RECORDER_H_

#include <stdbool.h>
#include <stdint.h>

#include "audio/pipeline.h"
#include "storage/policy.h"
#include "storage/recstore.h"

#ifdef __cplusplus
extern "C" {
#endif

#define MN_RECORDER_RING_SIZE 8192
#define MN_RECORDER_STORAGE_PRIORITY 6

enum mn_recorder_end {
    MN_REC_END_NONE,         /* still recording (or idle) */
    MN_REC_END_USER,         /* mn_recorder_stop(), or a source that ran out */
    MN_REC_END_LOW_BATTERY,  /* battery under 5% */
    MN_REC_END_STORAGE_FULL, /* §4.9 FULL */
    MN_REC_END_FAULT,        /* capture, encoder or storage error */
};

struct mn_recorder_config {
    const char *dir; /* the recstore directory */
    struct mn_audio_source source;
    uint16_t gain_q8;
    int complexity;
};

/* Starts the storage thread. Once, at boot. */
int mn_recorder_init(const struct mn_recorder_config *cfg);

/*
 * Starts a recording with these params (ID, timestamps, recipients). Returns
 * 0; -EBUSY if one is active; -ENOSPC if storage is FULL; -EPERM if the
 * battery is under 5%; or an error from recstore or the encoder.
 */
int mn_recorder_start(const struct mn_rec_params *p, enum mn_storage_state storage,
                      uint8_t battery_pct);

/* Stops the active recording: encodes what's left, writes it, closes the
 * file. Returns 0 or the first error the recording hit; -EALREADY if idle. */
int mn_recorder_stop(void);

/* Marks an item at the current position (§4.2). -EALREADY if idle,
 * -ENOBUFS if the ring is full. */
int mn_recorder_marker(uint8_t type);

/*
 * Call periodically while recording (main does it on each battery or
 * storage update) with the current battery and storage state. Finalizes the
 * active recording if the policy says so or the encoder thread died, and
 * returns why; MN_REC_END_NONE if nothing happened. *err (if not NULL) gets
 * the recording's error: 0 if it closed cleanly, always non-zero for
 * MN_REC_END_FAULT.
 */
enum mn_recorder_end mn_recorder_poll(enum mn_storage_state storage, uint8_t battery_pct, int *err);

bool mn_recorder_active(void);

/* The active recording's ID, or 0. */
uint64_t mn_recorder_rec_id(void);

#ifdef __cplusplus
}
#endif

#endif /* MICNOTE_RECORDER_H_ */
```

## src/timekeeping.c
```c
#include "timekeeping.h"

#include <errno.h>
#include <string.h>

#include <zephyr/kernel.h>
#include <zephyr/settings/settings.h>

#define BOOT_KEY "mn/boot"

void mn_clock_set(struct mn_clock *c, uint64_t unix_ms, int32_t tz_offset_min, int64_t uptime_ms)
{
    memset(c, 0, sizeof(*c));
    if (unix_ms == 0) {
        return;
    }
    c->valid = true;
    c->base_unix_ms = unix_ms;
    c->base_uptime_ms = uptime_ms;
    c->tz_offset_min = tz_offset_min;
}

uint64_t mn_clock_unix_ms(const struct mn_clock *c, int64_t uptime_ms)
{
    if (!c->valid) {
        return 0;
    }
    /* Uptime only goes forward; a caller passing an earlier one gets the
     * base time rather than a wrapped-around one. */
    if (uptime_ms < c->base_uptime_ms) {
        return c->base_unix_ms;
    }
    return c->base_unix_ms + (uint64_t)(uptime_ms - c->base_uptime_ms);
}

static struct mn_clock wall;
static uint32_t boot_count;
static uint32_t rec_counter;
static bool have_boot_count;

/* settings_load_subtree_direct() callback: the stored boot count. */
static int load_boot(const char *key, size_t len, settings_read_cb read_cb, void *cb_arg,
                     void *param)
{
    uint32_t *out = param;

    if (key != NULL || len != sizeof(*out)) {
        return 0; /* not ours, or the wrong size: start over from 0 */
    }
    if (read_cb(cb_arg, out, sizeof(*out)) != sizeof(*out)) {
        *out = 0;
    }
    return 0;
}

int mn_time_init(void)
{
    uint32_t stored = 0;
    int ret;

    memset(&wall, 0, sizeof(wall));
    boot_count = 0;
    rec_counter = 0;
    have_boot_count = false;

    ret = settings_load_subtree_direct(BOOT_KEY, load_boot, &stored);
    if (ret < 0) {
        return ret;
    }
    /* 0 is reserved for "unknown", so a counter that ran out stays at the
     * maximum rather than wrapping to it. */
    const uint32_t next = stored == UINT32_MAX ? UINT32_MAX : stored + 1;

    ret = settings_save_one(BOOT_KEY, &next, sizeof(next));
    if (ret < 0) {
        return ret;
    }
    boot_count = next;
    have_boot_count = true;
    return 0;
}

uint32_t mn_time_boot_count(void)
{
    return boot_count;
}

uint64_t mn_time_next_rec_id(void)
{
    if (!have_boot_count || rec_counter == UINT32_MAX) {
        return 0;
    }
    rec_counter++;
    return ((uint64_t)boot_count << 32) | rec_counter;
}

void mn_time_set(uint64_t unix_ms, int32_t tz_offset_min)
{
    mn_clock_set(&wall, unix_ms, tz_offset_min, k_uptime_get());
}

bool mn_time_valid(void)
{
    return wall.valid;
}

uint64_t mn_time_unix_ms(void)
{
    return mn_clock_unix_ms(&wall, k_uptime_get());
}

int32_t mn_time_tz_offset_min(void)
{
    return wall.tz_offset_min;
}
```

## src/timekeeping.h
```c
/*
 * Timekeeping (stage 1 §4.10): the boot counter, the wall clock a host sets,
 * and recording IDs.
 *
 * - boot_count lives in settings (NVS) under "mn/boot" and goes up by one at
 *   every mn_time_init().
 * - The wall clock is invalid until a host sends SetTime; after that,
 *   unix_ms = base_unix_ms + (uptime - base_uptime_ms). It's lost at reset.
 * - Recording IDs are (boot_count << 32) | n, with n = 1, 2, ... per boot, so
 *   they never repeat and sort in recording order.
 *
 * The clock math is the pure mn_clock_* functions; the mn_time_* functions
 * are one global instance of it on k_uptime_get().
 */
#ifndef MICNOTE_TIMEKEEPING_H_
#define MICNOTE_TIMEKEEPING_H_

#include <stdbool.h>
#include <stdint.h>

#ifdef __cplusplus
extern "C" {
#endif

struct mn_clock {
    bool valid;
    uint64_t base_unix_ms;
    int64_t base_uptime_ms;
    int32_t tz_offset_min;
};

/* Sets the clock: unix_ms is the time at uptime_ms. unix_ms == 0 is "no
 * time" and leaves the clock invalid. */
void mn_clock_set(struct mn_clock *c, uint64_t unix_ms, int32_t tz_offset_min, int64_t uptime_ms);

/* The Unix time at uptime_ms, or 0 while the clock isn't set. */
uint64_t mn_clock_unix_ms(const struct mn_clock *c, int64_t uptime_ms);

/* Loads boot_count from settings, adds one and saves it. Call once at boot,
 * after settings_subsys_init(). 0 or a negative errno; on error the device
 * still runs, with boot_count 0 for this boot. */
int mn_time_init(void);

uint32_t mn_time_boot_count(void);

/* The next recording ID for this boot, or 0 if this boot has used all 2^32 - 1
 * (or mn_time_init() failed: without a boot count, IDs could repeat). */
uint64_t mn_time_next_rec_id(void);

/* The global wall clock, on k_uptime_get(). */
void mn_time_set(uint64_t unix_ms, int32_t tz_offset_min);
bool mn_time_valid(void);
uint64_t mn_time_unix_ms(void);
int32_t mn_time_tz_offset_min(void);

#ifdef __cplusplus
}
#endif

#endif /* MICNOTE_TIMEKEEPING_H_ */
```
